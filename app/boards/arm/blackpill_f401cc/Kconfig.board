## app/boards/arm/blackpill_f401cc/Kconfig.board
```kconfig
# STM32F401CC based Black Pill V3.0 board configuration

# Copyright (c) 2020 Mega Mind
# SPDX-License-Identifier: Apache-2.0

config BOARD_BLACKPILL_F401CC
	bool "WeAct Studio Black Pill F401 V3.0 Board"
	depends on SOC_STM32F401XC
```

## app/boards/arm/blackpill_f401cc/Kconfig.defconfig
```kconfig
# Copyright (c) 2020 Mega Mind
# SPDX-License-Identifier: Apache-2.0

# F411CE based Black Pill F401 V3.0 board board configuration

if BOARD_BLACKPILL_F401CC

config BOARD
	default "blackpill_f401cc"

config SPI_STM32_INTERRUPT
	default y
	depends on SPI

config ZMK_USB
	default y

endif # BOARD_BLACKPILL_F401CC
```

## app/boards/arm/bluepill/Kconfig.board
```kconfig
# STM32 Minimum Development Board Configuration

# Copyright (c) 2017, embedjournal.com
# SPDX-License-Identifier: Apache-2.0

config BOARD_BLUEPILL_F103C8
	bool "WeAct Studio Blue Pill F103 V1.0 Board"
	depends on SOC_STM32F103X8
```

## app/boards/arm/bluepill/Kconfig.defconfig
```kconfig
# SPDX-License-Identifier: Apache-2.0

if BOARD_BLUEPILL_F103C8

config BOARD
	default "bluepill" if BOARD_BLUEPILL_F103C8

config ZMK_USB
    default y

endif # BOARD_BLUEPILL_F103C8
```

## app/boards/arm/cyber60b/Kconfig.board
```kconfig
# cyber60 board configuration

# Copyright (c) 2020 Stefan Sundin (4pplet)
# SPDX-License-Identifier: MIT

config BOARD_CYBER60B
	bool "Cyber60 Rev B"
	depends on SOC_NRF52840_QIAA
```

## app/boards/shields/2key/Kconfig.defconfig
```kconfig
# Copyright (c) 2020 Mega Mind
# SPDX-License-Identifier: MIT

if SHIELD_2KEY

config ZMK_KEYBOARD_NAME
	default "2key"

config ZMK_KSCAN_GPIO_POLLING
	default y

endif
```

## app/boards/shields/2key/Kconfig.shield
```kconfig
# Copyright (c) 2020 Mega Mind
# SPDX-License-Identifier: MIT

config SHIELD_2KEY
	def_bool $(shields_list_contains,2key)
```

## app/boards/shields/chocolad/Kconfig.defconfig
```kconfig
# Copyright (c) 2020 The ZMK Contributors
# SPDX-License-Identifier: MIT

if SHIELD_CHOCOLAD_DONGLE

config ZMK_KEYBOARD_NAME
	default "Chocolad"

config ZMK_SPLIT_BLE_ROLE_CENTRAL
	default y

config ZMK_USB
	default y

endif

if SHIELD_CHOCOLAD_LEFT

config ZMK_KEYBOARD_NAME
	default "Chocolad Left"

endif

if SHIELD_CHOCOLAD_RIGHT

config ZMK_KEYBOARD_NAME
	default "Chocolad Right"

endif

if SHIELD_CHOCOLAD_LEFT || SHIELD_CHOCOLAD_RIGHT || SHIELD_CHOCOLAD_DONGLE

config ZMK_SPLIT
	default y

config ZMK_BLE
	default y

endif # SHIELD_CHOCOLAD_LEFT || SHIELD_CHOCOLAD_RIGHT || SHIELD_CHOCOLAD_DONGLE
```

## app/boards/shields/chocolad/Kconfig.shield
```kconfig
# Copyright (c) 2020 The ZMK Contributors
# SPDX-License-Identifier: MIT

config SHIELD_CHOCOLAD_DONGLE
	def_bool $(shields_list_contains,chocolad_dongle)

config SHIELD_CHOCOLAD_LEFT
	def_bool $(shields_list_contains,chocolad_left)

config SHIELD_CHOCOLAD_RIGHT
	def_bool $(shields_list_contains,chocolad_right)
```

## app/boards/shields/draculad/Kconfig.shield
```kconfig
# Copyright (c) 2020 The ZMK Contributors
# SPDX-License-Identifier: MIT

config SHIELD_DRACULAD_LEFT
	def_bool $(shields_list_contains,draculad_left)

config SHIELD_DRACULAD_RIGHT
	def_bool $(shields_list_contains,draculad_right)
```
