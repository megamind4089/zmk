/*
 * Copyright (c) 2020 Mega Mind
 *
 * SPDX-License-Identifier: MIT
 */

#include <behaviors.dtsi>
#include <dt-bindings/zmk/keys.h>

/ {
    keymap {
        compatible = "zmk,keymap";

        default_layer {
            bindings = < &kp LGUI &kp LGUI >;
        };
    };
};


